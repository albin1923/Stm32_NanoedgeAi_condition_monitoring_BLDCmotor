# file: stm32cubemx.ioc
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ADC1.Channel-0\#ChannelRegularConversion=ADC_CHANNEL_15
ADC1.ExternalTrigConv=ADC_EXTERNALTRIG_T2_TRGO
ADC1.NbrOfConversionFlag=1
ADC1.OffsetNumber-0\#ChannelRegularConversion=ADC_OFFSET_NONE
ADC1.Rank-0\#ChannelRegularConversion=1
ADC1.SamplingTime-0\#ChannelRegularConversion=ADC_SAMPLETIME_2CYCLES_5
ADC1.master=1
Dma.ADC1.0.Direction=DMA_PERIPH_TO_MEMORY
Dma.ADC1.0.EventEnable=DISABLE
Dma.ADC1.0.Instance=DMA1_Channel1
Dma.ADC1.0.MemDataAlignment=DMA_MDATAALIGN_HALFWORD
Dma.ADC1.0.MemInc=DMA_MINC_ENABLE
Dma.ADC1.0.Mode=DMA_CIRCULAR
Dma.ADC1.0.PeriphDataAlignment=DMA_PDATAALIGN_HALFWORD
Dma.ADC1.0.PeriphInc=DMA_PINC_DISABLE
Dma.ADC1.0.Polarity=HAL_DMAMUX_REQ_GEN_RISING
Dma.ADC1.0.Priority=DMA_PRIORITY_LOW
Dma.ADC1.0.RequestNumber=1
Dma.ADC1.0.SignalID=NONE
Dma.ADC1.0.SyncEnable=DISABLE
Dma.ADC1.0.SyncPolarity=HAL_DMAMUX_SYNC_NO_EVENT
Dma.ADC1.0.SyncRequestNumber=1
Dma.ADC1.0.SyncSignalID=NONE
Dma.Request0=ADC1
Mcu.Family=STM32G4
Mcu.Name=STM32G474R(B-C-E)Tx
Mcu.Package=LQFP64
NUCLEO-G474RE.BUTTON=1
NUCLEO-G474RE.LD2=true
NUCLEO-G474RE.VCP=true
NVIC.DMA1_Channel1_IRQn=true\:0\:0\:false\:false\:true\:false\:true\:true
NVIC.EXTI15_10_IRQn=true\:0\:0\:false\:false\:true\:false\:true\:true
NVIC.PriorityGroup=NVIC_PRIORITYGROUP_4
PA13.GPIO_Label=T_SWDIO
PA13.Signal=SYS_JTMS-SWDIO
PA14.GPIO_Label=T_SWCLK
PA14.Signal=SYS_JTCK-SWCLK
PA2.Signal=LPUART1_TX
PA3.Signal=LPUART1_RX
PB0.Mode=IN15-Single-Ended
PB0.Signal=ADC1_IN15
PB3.GPIO_Label=T_SWO
PB3.Signal=SYS_JTDO-SWO
PC14-OSC32_IN.GPIO_Label=RCC_OSC32_IN
PC14-OSC32_IN.Signal=RCC_OSC32_IN
PC15-OSC32_OUT.GPIO_Label=RCC_OSC32_OUT
PC15-OSC32_OUT.Signal=RCC_OSC32_OUT
PF0-OSC_IN.GPIO_Label=RCC_OSC_IN
PF0-OSC_IN.Signal=RCC_OSC_IN
PF1-OSC_OUT.GPIO_Label=RCC_OSC_OUT
PF1-OSC_OUT.Signal=RCC_OSC_OUT
ProjectManager.HeapSize=0x200
ProjectManager.StackSize=0x400
ProjectManager.TargetToolchain=CMake
RCC.ADC12Freq_Value=170000000
RCC.ADC345Freq_Value=170000000
RCC.AHBFreq_Value=170000000
RCC.APB1Freq_Value=170000000
RCC.APB1TimFreq_Value=170000000
RCC.APB2Freq_Value=170000000
RCC.APB2TimFreq_Value=170000000
RCC.CortexFreq_Value=170000000
RCC.EXTERNAL_CLOCK_VALUE=12288000
RCC.HCLKFreq_Value=170000000
RCC.HSE_VALUE=24000000
RCC.HSI48_VALUE=48000000
RCC.HSI_VALUE=16000000
RCC.LSE_VALUE=32768
RCC.PLLM=RCC_PLLM_DIV4
RCC.PLLN=85
RCC.RTCClockSelection=RCC_RTCCLKSOURCE_LSE
RCC.SYSCLKFreq_VALUE=170000000
RCC.SYSCLKSource=RCC_SYSCLKSOURCE_PLLCLK
RCC.USBFreq_Value=170000000
RCC.VCOOutputFreq_Value=340000000
TIM2.PeriodNoDither=200-1
TIM2.Prescaler=170-1
TIM2.TIM_MasterOutputTrigger=TIM_TRGO_UPDATE
VP_NUCLEO-G474RE_VS_BSP_COMMON.Mode=COMMON
VP_SYS_VS_DBSignals.Mode=DisableDeadBatterySignals
VP_TIM2_VS_ClockSourceINT.Mode=Internal
board=NUCLEO-G474RE

// file: Core/Src/main.c
/* USER CODE BEGIN Header */
/**
  ******************************************************************************
  * @file           : main.c
  * @brief          : BLDC Motor Condition Monitoring — STM32 NUCLEO-G474RE
  *
  *  Hardware:
  *    • MCU:    STM32G474RET6 (Cortex-M4F, 170 MHz)
  *    • Sensor: ACS724-50A on PB0 (ADC1_IN15), zero-current = 2.5V ≈ 3103 counts
  *    • Motor:  12V/10A BLDC via SimonK 30A ESC
  *    • UART:   LPUART1 (PA2/PA3) → ST-Link VCP, 115200 baud
  *
  *  Modes (toggle via MODE_SELECT define below):
  *    MODE_CLASSIFICATION : 5-class NanoEdge AI inference → UART class output
  *    MODE_DATA_LOGGER    : Raw ADC streaming → UART (for dataset collection)
  *
  *  Pipeline:
  *    TIM2 (5 kHz TRGO) → ADC1 (12-bit, PB0) → DMA1_CH1 (Circular, 256 samples)
  ******************************************************************************
  */
/* USER CODE END Header */
#include "main.h"

/* USER CODE BEGIN Includes */
#include <stdio.h>
#include <string.h>

/* ══════════════════════════════════════════════════════════════════════
 *  MODE SELECT — Change this define to switch firmware behaviour:
 *    MODE_CLASSIFICATION  →  5-class NanoEdge AI inference (default)
 *    MODE_DATA_LOGGER     →  Raw ADC value streaming for data collection
 * ══════════════════════════════════════════════════════════════════════ */
#define MODE_CLASSIFICATION
// #define MODE_DATA_LOGGER

#ifdef MODE_CLASSIFICATION
  #include "NanoEdgeAI.h"
#endif
/* USER CODE END Includes */

/* USER CODE BEGIN PD */

/* ── Sensor / ADC Constants ── */
#define ADC_ZERO_POINT        3103U   /* ACS724 zero-current offset (2.5V on 3.3V/12-bit) */
#define DMA_BUFFER_SIZE       256U    /* 256 samples per buffer (matches NEAI_INPUT_SIGNAL_LENGTH) */

/* USER CODE END PD */

COM_InitTypeDef BspCOMInit;
ADC_HandleTypeDef hadc1;
DMA_HandleTypeDef hdma_adc1;

TIM_HandleTypeDef htim2;

/* USER CODE BEGIN PV */

/**
 * @brief Raw ADC DMA circular buffer — filled automatically by hardware.
 *        DMA fires HAL_ADC_ConvHalfCpltCallback when [0..127] is complete,
 *        and HAL_ADC_ConvCpltCallback when [128..255] is complete.
 */
static uint16_t adc_dma_buffer[DMA_BUFFER_SIZE];

#ifdef MODE_CLASSIFICATION
/**
 * @brief Float buffer for NanoEdge AI input.
 *        Size matches NEAI_INPUT_SIGNAL_LENGTH (256).
 */
static float ai_input_buffer[DMA_BUFFER_SIZE];

/* ── Classification variables ── */
int id_class = 0;
float probabilities[NEAI_NUMBER_OF_CLASSES];
#endif

/**
 * @brief Volatile flags set by DMA ISR, polled in main loop.
 *        dma_half_cplt: first half [0..127] ready
 *        dma_full_cplt: second half [128..255] ready (full buffer available)
 */
static volatile uint8_t dma_half_cplt = 0;
static volatile uint8_t dma_full_cplt = 0;

/* USER CODE END PV */

void SystemClock_Config(void);
static void MX_GPIO_Init(void);
static void MX_DMA_Init(void);
static void MX_ADC1_Init(void);
static void MX_TIM2_Init(void);

/* USER CODE BEGIN 0 */

/* ═══════════════════════════════════════════════════════════════════════════
 *                         PRINTF RETARGETING
 *
 *  Routes printf() output to LPUART1 (ST-Link Virtual COM Port).
 *  This overrides the weak _write() syscall used by newlib-nano.
 * ═══════════════════════════════════════════════════════════════════════════ */

int _write(int file, char *ptr, int len)
{
    (void)file;
    HAL_UART_Transmit(&hcom_uart[COM1], (uint8_t *)ptr, (uint16_t)len, HAL_MAX_DELAY);
    return len;
}

/* USER CODE END 0 */

int main(void)
{

  /* MCU Configuration--------------------------------------------------------*/

  /* Reset of all peripherals, Initializes the Flash interface and the Systick. */
  HAL_Init();

  /* Configure the system clock */
  SystemClock_Config();

  /* Initialize all configured peripherals */
  MX_GPIO_Init();
  MX_DMA_Init();
  MX_ADC1_Init();
  MX_TIM2_Init();
  /* USER CODE BEGIN 2 */

  /* ── Initialize BSP Components ── */
  BSP_LED_Init(LED_GREEN);
  BSP_PB_Init(BUTTON_USER, BUTTON_MODE_EXTI);

  /* ── Initialize COM1 for BSP printf (optional, LPUART1 already handles it) ── */
  BspCOMInit.BaudRate   = 115200;
  BspCOMInit.WordLength = COM_WORDLENGTH_8B;
  BspCOMInit.StopBits   = COM_STOPBITS_1;
  BspCOMInit.Parity     = COM_PARITY_NONE;
  BspCOMInit.HwFlowCtl  = COM_HWCONTROL_NONE;
  if (BSP_COM_Init(COM1, &BspCOMInit) != BSP_ERROR_NONE)
  {
      Error_Handler();
  }

  /* ── ADC Calibration (recommended before first conversion on STM32G4) ── */
  if (HAL_ADCEx_Calibration_Start(&hadc1, ADC_SINGLE_ENDED) != HAL_OK)
  {
      Error_Handler();
  }

#ifdef MODE_CLASSIFICATION
  /* ── NanoEdge AI Engine (5-class classification) ── */
  enum neai_state neai_ret = neai_classification_init();
  if (neai_ret != NEAI_OK)
  {
      Error_Handler();
  }
#endif

  /* ──────────────────────────────────────────────────────────────────────
   *  Start the TIM2→ADC→DMA acquisition pipeline.
   *  DMA fills adc_dma_buffer[256] in circular mode.
   *  When full, HAL_ADC_ConvCpltCallback sets dma_full_cplt = 1.
   * ────────────────────────────────────────────────────────────────────── */

  /* Start ADC+DMA in circular mode (256 half-words) */
  HAL_ADC_Start_DMA(&hadc1, (uint32_t *)adc_dma_buffer, DMA_BUFFER_SIZE);

  /* Start TIM2 — TRGO update events begin triggering ADC at 5 kHz */
  HAL_TIM_Base_Start(&htim2);

  /* USER CODE END 2 */

  /* Infinite loop */
  while (1)
  {

    /* USER CODE BEGIN 3 */

        if (dma_full_cplt)
        {
            dma_full_cplt = 0;
            HAL_ADC_Stop_DMA(&hadc1);   /* Pause DMA while we process */

#ifdef MODE_CLASSIFICATION
            /* ── Classification path ── */
            /* 1. Convert raw ADC data into floats */
            for (int i = 0; i < DMA_BUFFER_SIZE; i++) {
                ai_input_buffer[i] = (float)adc_dma_buffer[i];
            }

            /* 2. Run 5-Class Classification */
            neai_classification(ai_input_buffer, probabilities, &id_class);

            /* 3. Print the result using the class name from the library */
            const char *class_name = neai_get_class_name(id_class);
            printf("State: %s (%.1f%% sure)\r\n",
                   class_name ? class_name : "Unknown",
                   probabilities[id_class] * 100.0f);
#else
            /* ── Data logger path ── */
            /* Stream 256 raw ADC values as space-separated line for NanoEdge AI Studio */
            for (int i = 0; i < DMA_BUFFER_SIZE; i++)
            {
                if (i < DMA_BUFFER_SIZE - 1)
                    printf("%u ", (unsigned int)adc_dma_buffer[i]);
                else
                    printf("%u\r\n", (unsigned int)adc_dma_buffer[i]);
            }
#endif

            HAL_ADC_Start_DMA(&hadc1, (uint32_t *)adc_dma_buffer, DMA_BUFFER_SIZE);  /* Resume */
        }

  }
  /* USER CODE END 3 */
}

void SystemClock_Config(void)
{
  RCC_OscInitTypeDef RCC_OscInitStruct = {0};
  RCC_ClkInitTypeDef RCC_ClkInitStruct = {0};

  /** Configure the main internal regulator output voltage
  */
  HAL_PWREx_ControlVoltageScaling(PWR_REGULATOR_VOLTAGE_SCALE1_BOOST);

  /** Initializes the RCC Oscillators according to the specified parameters
  * in the RCC_OscInitTypeDef structure.
  */
  RCC_OscInitStruct.OscillatorType = RCC_OSCILLATORTYPE_HSI;
  RCC_OscInitStruct.HSIState = RCC_HSI_ON;
  RCC_OscInitStruct.HSICalibrationValue = RCC_HSICALIBRATION_DEFAULT;
  RCC_OscInitStruct.PLL.PLLState = RCC_PLL_ON;
  RCC_OscInitStruct.PLL.PLLSource = RCC_PLLSOURCE_HSI;
  RCC_OscInitStruct.PLL.PLLM = RCC_PLLM_DIV4;
  RCC_OscInitStruct.PLL.PLLN = 85;
  RCC_OscInitStruct.PLL.PLLP = RCC_PLLP_DIV2;
  RCC_OscInitStruct.PLL.PLLQ = RCC_PLLQ_DIV2;
  RCC_OscInitStruct.PLL.PLLR = RCC_PLLR_DIV2;
  if (HAL_RCC_OscConfig(&RCC_OscInitStruct) != HAL_OK)
  {
    Error_Handler();
  }

  /** Initializes the CPU, AHB and APB buses clocks
  */
  RCC_ClkInitStruct.ClockType = RCC_CLOCKTYPE_HCLK|RCC_CLOCKTYPE_SYSCLK
                              |RCC_CLOCKTYPE_PCLK1|RCC_CLOCKTYPE_PCLK2;
  RCC_ClkInitStruct.SYSCLKSource = RCC_SYSCLKSOURCE_PLLCLK;
  RCC_ClkInitStruct.AHBCLKDivider = RCC_SYSCLK_DIV1;
  RCC_ClkInitStruct.APB1CLKDivider = RCC_HCLK_DIV1;
  RCC_ClkInitStruct.APB2CLKDivider = RCC_HCLK_DIV1;

  if (HAL_RCC_ClockConfig(&RCC_ClkInitStruct, FLASH_LATENCY_4) != HAL_OK)
  {
    Error_Handler();
  }
}

static void MX_ADC1_Init(void)
{

  ADC_MultiModeTypeDef multimode = {0};
  ADC_ChannelConfTypeDef sConfig = {0};

  /** Common config
  */
  hadc1.Instance = ADC1;
  hadc1.Init.ClockPrescaler = ADC_CLOCK_SYNC_PCLK_DIV4;
  hadc1.Init.Resolution = ADC_RESOLUTION_12B;
  hadc1.Init.DataAlign = ADC_DATAALIGN_RIGHT;
  hadc1.Init.GainCompensation = 0;
  hadc1.Init.ScanConvMode = ADC_SCAN_DISABLE;
  hadc1.Init.EOCSelection = ADC_EOC_SINGLE_CONV;
  hadc1.Init.LowPowerAutoWait = DISABLE;
  hadc1.Init.ContinuousConvMode = DISABLE;
  hadc1.Init.NbrOfConversion = 1;
  hadc1.Init.DiscontinuousConvMode = DISABLE;
  hadc1.Init.ExternalTrigConv = ADC_EXTERNALTRIG_T2_TRGO;
  hadc1.Init.ExternalTrigConvEdge = ADC_EXTERNALTRIGCONVEDGE_RISING;
  hadc1.Init.DMAContinuousRequests = DISABLE;
  hadc1.Init.Overrun = ADC_OVR_DATA_PRESERVED;
  hadc1.Init.OversamplingMode = DISABLE;
  if (HAL_ADC_Init(&hadc1) != HAL_OK)
  {
    Error_Handler();
  }

  /** Configure the ADC multi-mode
  */
  multimode.Mode = ADC_MODE_INDEPENDENT;
  if (HAL_ADCEx_MultiModeConfigChannel(&hadc1, &multimode) != HAL_OK)
  {
    Error_Handler();
  }

  /** Configure Regular Channel
  */
  sConfig.Channel = ADC_CHANNEL_15;
  sConfig.Rank = ADC_REGULAR_RANK_1;
  sConfig.SamplingTime = ADC_SAMPLETIME_2CYCLES_5;
  sConfig.SingleDiff = ADC_SINGLE_ENDED;
  sConfig.OffsetNumber = ADC_OFFSET_NONE;
  sConfig.Offset = 0;
  if (HAL_ADC_ConfigChannel(&hadc1, &sConfig) != HAL_OK)
  {
    Error_Handler();
  }

}

static void MX_TIM2_Init(void)
{

  TIM_ClockConfigTypeDef sClockSourceConfig = {0};
  TIM_MasterConfigTypeDef sMasterConfig = {0};

  htim2.Instance = TIM2;
  htim2.Init.Prescaler = 170-1;
  htim2.Init.CounterMode = TIM_COUNTERMODE_UP;
  htim2.Init.Period = 199;
  htim2.Init.ClockDivision = TIM_CLOCKDIVISION_DIV1;
  htim2.Init.AutoReloadPreload = TIM_AUTORELOAD_PRELOAD_DISABLE;
  if (HAL_TIM_Base_Init(&htim2) != HAL_OK)
  {
    Error_Handler();
  }
  sClockSourceConfig.ClockSource = TIM_CLOCKSOURCE_INTERNAL;
  if (HAL_TIM_ConfigClockSource(&htim2, &sClockSourceConfig) != HAL_OK)
  {
    Error_Handler();
  }
  sMasterConfig.MasterOutputTrigger = TIM_TRGO_UPDATE;
  sMasterConfig.MasterSlaveMode = TIM_MASTERSLAVEMODE_DISABLE;
  if (HAL_TIMEx_MasterConfigSynchronization(&htim2, &sMasterConfig) != HAL_OK)
  {
    Error_Handler();
  }

}

static void MX_DMA_Init(void)
{

  /* DMA controller clock enable */
  __HAL_RCC_DMAMUX1_CLK_ENABLE();
  __HAL_RCC_DMA1_CLK_ENABLE();

  /* DMA interrupt init */
  /* DMA1_Channel1_IRQn interrupt configuration */
  HAL_NVIC_SetPriority(DMA1_Channel1_IRQn, 0, 0);
  HAL_NVIC_EnableIRQ(DMA1_Channel1_IRQn);

}

static void MX_GPIO_Init(void)
{

  /* GPIO Ports Clock Enable */
  __HAL_RCC_GPIOC_CLK_ENABLE();
  __HAL_RCC_GPIOF_CLK_ENABLE();
  __HAL_RCC_GPIOB_CLK_ENABLE();
  __HAL_RCC_GPIOA_CLK_ENABLE();

}

/* USER CODE BEGIN 4 */

/* ═══════════════════════════════════════════════════════════════════════════
 *                      DMA INTERRUPT CALLBACKS
 *
 *  Called from DMA1_Channel1_IRQHandler → HAL_DMA_IRQHandler().
 *  RULE: Never call AI functions or printf inside ISRs — set a flag only.
 *        All heavy processing happens in the main while(1) loop.
 *
 *  DMA Circular Mode with 256-element buffer:
 *    • Half-Transfer (HT): elements [0..127] are stable, DMA fills [128..255]
 *    • Transfer-Complete (TC): elements [128..255] are stable, DMA refills [0..127]
 *
 *  For this pipeline we use the FULL buffer on TC for processing (AI inference
 *  or raw streaming). The HT callback is provided for future use
 *  (e.g., double-buffering or streaming partial results).
 * ═══════════════════════════════════════════════════════════════════════════ */

/**
 * @brief DMA Half-Transfer Complete callback.
 *        First 128 samples [0..127] are now stable.
 *        Sets flag for potential future use (partial processing).
 */
void HAL_ADC_ConvHalfCpltCallback(ADC_HandleTypeDef *hadc)
{
    if (hadc->Instance == ADC1)
    {
        dma_half_cplt = 1;
    }
}

/**
 * @brief DMA Transfer Complete callback.
 *        Full 256-sample buffer is now complete.
 *        Sets flag — main loop will process the buffer.
 *
 * @note  Timer is NOT stopped. DMA circular mode continuously overwrites
 *        the buffer. The main loop must process before the next TC fires,
 *        or data will be overwritten. At 5 kHz / 256 samples = ~51 ms
 *        per buffer, which is ample time for inference on Cortex-M4F.
 */
void HAL_ADC_ConvCpltCallback(ADC_HandleTypeDef *hadc)
{
    if (hadc->Instance == ADC1)
    {
        dma_full_cplt = 1;
    }
}

/* USER CODE END 4 */

void Error_Handler(void)
{
  /* USER CODE BEGIN Error_Handler_Debug */
  __disable_irq();
  while (1)
  {
      /* Optionally toggle LED for visual error indication */
  }
  /* USER CODE END Error_Handler_Debug */
}
#ifdef USE_FULL_ASSERT
/**
  * @brief  Reports the name of the source file and the source line number
  *         where the assert_param error has occurred.
  * @param  file: pointer to the source file name
  * @param  line: assert_param error line source number
  * @retval None
  */
void assert_failed(uint8_t *file, uint32_t line)
{
  /* USER CODE BEGIN 6 */
  printf("Assert failed: %s line %lu\r\n", (char *)file, (unsigned long)line);
  /* USER CODE END 6 */
}
#endif /* USE_FULL_ASSERT */
